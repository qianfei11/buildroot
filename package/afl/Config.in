## package/afl/Config.in
```kconfig
config BR2_PACKAGE_AFL
	bool "afl"
	help
	  American fuzzy lop is a security-oriented fuzzer that 
	  employs a novel type of compile-time instrumentation and 
	  genetic algorithms to automatically discover clean, 
	  interesting test cases that trigger new internal states 
	  in the targeted binary.

	  https://lcamtuf.coredump.cx/afl/
```
